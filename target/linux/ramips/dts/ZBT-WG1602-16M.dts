/dts-v1/;

#include "ZBT-WG1602.dtsi"

/ {
	compatible = "zbtlink,zbt-wg1602-16m", "zbtlink,zbt-wg1602", "mediatek,mt7621-soc";
	model = "ZBT-WG1602 (16M)";
};

&firmware {
	reg = <0x50000 0xfb0000>;
};
